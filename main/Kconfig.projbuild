## sdkconfig.defaults
```kconfig
# OTA Rollback
CONFIG_BOOTLOADER_APP_ROLLBACK_ENABLE=y

# Flash & Partition Table
CONFIG_ESPTOOLPY_FLASHSIZE_4MB=y
CONFIG_PARTITION_TABLE_CUSTOM=y
CONFIG_PARTITION_TABLE_FILENAME="partitions.csv"

# MMU Page Size
CONFIG_MMU_PAGE_SIZE_64KB=y

# BLE - NimBLE stack
CONFIG_BT_NIMBLE_ENABLED=y

# mbedTLS threading (required for multi-threaded TLS / corePKCS11)
CONFIG_MBEDTLS_THREADING_C=y
CONFIG_MBEDTLS_THREADING_ALT=n
CONFIG_MBEDTLS_THREADING_PTHREAD=y

# Main task stack (provisioning BLE scheme requires more)
CONFIG_ESP_MAIN_TASK_STACK_SIZE=8192

# esp_secure_cert_mgr — use plain key in encrypted flash partition, not DS peripheral.
# The partition itself is encrypted via the partition table's `encrypted` flag.
# DS would add HSM-grade key protection but requires extra ciphertext+HMAC artifacts
# that the simple configure_esp_secure_cert.py partition-only flow doesn't produce.
CONFIG_ESP_SECURE_CERT_DS_PERIPHERAL=n

# Project-specific
CONFIG_LOGI_DEFAULT_FILL_DWELL_TIME_S=3000
CONFIG_HTTPD_MAX_REQ_HDR_LEN=512
CONFIG_LOG_COLORS=y

# REQ-PROV-02: power-management framework for light sleep during prov window.
# Ports the proven-good config from the sleep-test repo light-sleep-test branch
# (~3.79 mA @ 1000ms BLE ADV). PM auto-enters light sleep when FreeRTOS is idle;
# explicit PM locks gate this on/off per phase (prov = allow, duty cycle = deny).
CONFIG_PM_ENABLE=y
CONFIG_FREERTOS_USE_TICKLESS_IDLE=y
CONFIG_BT_LE_SLEEP_ENABLE=y
CONFIG_ESP_PHY_MAC_BB_PD=y

# v1.2.1: keep the device OUT of auto light sleep while a USB host is attached
# to the USB-Serial-JTAG port. Without this, the 48h provisioning window's
# light sleep killed the USJ console/flash port (ISS-006, Nick bug report
# board 2 "port closes"). Field units (no USB attached) still light-sleep.
CONFIG_USJ_NO_AUTO_LS_ON_CONNECTION=y

# v1.3.0: board rev 4.1+ carries Y1 = 32.768 kHz crystal on IO0/IO1 (the rev-4.1
# analog map freed those pins from ADC duty). External crystal as RTC slow clock
# gives accurate deep-sleep wake timing and is the only LP clock that supports
# full BLE through light sleep (per IDF BT_LE_LP_CLK_SRC help). On a rev-4.0
# board (no crystal) IDF falls back to the internal RC with a boot warning.
CONFIG_RTC_CLK_SRC_EXT_CRYS=y
CONFIG_BT_LE_LP_CLK_SRC_DEFAULT=y

# Production footprint: keep the OTA app below the 80% target.
CONFIG_COMPILER_OPTIMIZATION_DEBUG=n
CONFIG_COMPILER_OPTIMIZATION_SIZE=y
CONFIG_COMPILER_OPTIMIZATION_ASSERTIONS_ENABLE=n
CONFIG_COMPILER_OPTIMIZATION_ASSERTIONS_DISABLE=y
CONFIG_COMPILER_OPTIMIZATION_ASSERTION_LEVEL=0
CONFIG_COMPILER_OPTIMIZATION_LEVEL_DEBUG=n
CONFIG_COMPILER_OPTIMIZATION_DEFAULT=n
CONFIG_COMPILER_OPTIMIZATION_LEVEL_RELEASE=y

# We pin AWS IoT to the bundled/root CA provided by the app, so do not include
# ESP-IDF's full x509 certificate bundle.
CONFIG_MBEDTLS_CERTIFICATE_BUNDLE=n
CONFIG_MBEDTLS_CERTIFICATE_BUNDLE_DEFAULT_FULL=n
CONFIG_MBEDTLS_TLS_SERVER_AND_CLIENT=n
CONFIG_MBEDTLS_TLS_CLIENT_ONLY=y
CONFIG_MBEDTLS_SSL_RENEGOTIATION=n
CONFIG_MBEDTLS_SERVER_SSL_SESSION_TICKETS=n
CONFIG_MBEDTLS_ERROR_STRINGS=n
CONFIG_MQTT_TRANSPORT_WEBSOCKET=n
CONFIG_MQTT_TRANSPORT_WEBSOCKET_SECURE=n

# BLE provisioning only needs this device as a peripheral/GATT server.
CONFIG_BT_NIMBLE_ROLE_CENTRAL=n
CONFIG_BT_NIMBLE_ROLE_PERIPHERAL=y
CONFIG_BT_NIMBLE_ROLE_BROADCASTER=y
CONFIG_BT_NIMBLE_ROLE_OBSERVER=n
CONFIG_BT_NIMBLE_GATT_CLIENT=n
CONFIG_BT_NIMBLE_GATT_SERVER=y
CONFIG_BT_NIMBLE_50_FEATURE_SUPPORT=n
CONFIG_BT_NIMBLE_LL_CFG_FEAT_LE_2M_PHY=n
CONFIG_BT_NIMBLE_LL_CFG_FEAT_LE_CODED_PHY=n
CONFIG_BT_NIMBLE_EXT_SCAN=n
CONFIG_BT_NIMBLE_ENABLE_PERIODIC_SYNC=n
CONFIG_BT_NIMBLE_PROX_SERVICE=n
CONFIG_BT_NIMBLE_ANS_SERVICE=n
CONFIG_BT_NIMBLE_CTS_SERVICE=n
CONFIG_BT_NIMBLE_HTP_SERVICE=n
CONFIG_BT_NIMBLE_IPSS_SERVICE=n
CONFIG_BT_NIMBLE_TPS_SERVICE=n
CONFIG_BT_NIMBLE_IAS_SERVICE=n
CONFIG_BT_NIMBLE_LLS_SERVICE=n
CONFIG_BT_NIMBLE_SPS_SERVICE=n
CONFIG_BT_NIMBLE_HR_SERVICE=n
CONFIG_BT_NIMBLE_BAS_SERVICE=n
CONFIG_BT_NIMBLE_DIS_SERVICE=n
CONFIG_NIMBLE_ROLE_CENTRAL=n
CONFIG_NIMBLE_ROLE_PERIPHERAL=y
CONFIG_NIMBLE_ROLE_BROADCASTER=y
CONFIG_NIMBLE_ROLE_OBSERVER=n

# This product provisions over BLE and runs Wi-Fi in STA mode.
CONFIG_ESP_WIFI_ENABLE_WPA3_SAE=n
CONFIG_ESP_WIFI_ENABLE_SAE_PK=n
CONFIG_ESP_WIFI_ENABLE_SAE_H2E=n
CONFIG_ESP_WIFI_SOFTAP_SAE_SUPPORT=n
CONFIG_ESP_WIFI_ENABLE_WPA3_OWE_STA=n
CONFIG_ESP_WIFI_GMAC_SUPPORT=n
CONFIG_ESP_WIFI_SOFTAP_SUPPORT=n
CONFIG_ESP_WIFI_ENTERPRISE_SUPPORT=n
CONFIG_LWIP_DHCPS=n
CONFIG_LWIP_IPV6=n
```
